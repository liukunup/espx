## components/led_driver/Kconfig
```kconfig
menu "LED Driver"

    config LED_GPIO
        int "LED GPIO Pin"
        default 48
        help
            GPIO pin connected to the status LED.

endmenu
```

## main/Kconfig.projbuild
```kconfig
menu "ESPX Configuration"

    config ESPX
        bool "Enable ESPX"
        default y

    config DEVICE_NAME
        string "Device Name"
        default "ESPX"
        depends on ESPX

    # The firmware version lives in version.txt at the project root, which
    # ESP-IDF compiles into the application descriptor. Keeping a second copy
    # here would let the node identity and the OTA version disagree.

    config MFG_TEST_GPIO
        int "Manufacturing Test trigger GPIO (-1 = disabled)"
        default -1
        depends on ESPX
        help
            GPIO held LOW at boot to enter manufacturing test mode.

            Set to -1 (default) to disable the boot-time GPIO trigger.

            WARNING: do not use a strapping pin (GPIO0/GPIO3/GPIO45/GPIO46 on
            ESP32-S3). Holding GPIO0 low across reset makes the chip enter the
            ROM UART download mode, so the application never runs.

            With the trigger disabled, test mode is still reachable by holding
            the BOOT button for ~3 s while the application is running, from the
            Web UI, or over MQTT.

    config LED_GPIO
        int "Status LED GPIO (-1 = disabled)"
        default -1
        depends on ESPX
        help
            GPIO of a single WS2812 status LED driven by the led_driver
            component. Set to -1 (default) to disable it.

            Note: the ws2812 peripheral driver can also drive the same LED. Do
            not enable both on the same GPIO: they create separate RMT channels
            and will fight over the pin.

    config LED_STRIP_LENGTH
        int "LED Strip Length"
        default 1
        depends on ESPX
        help
            Number of LEDs in the strip

    config MQTT_BROKER_URL
        string "Default MQTT Broker URL"
        default "mqtt://localhost:1883"
        depends on ESPX
        help
            Used only when no broker has been configured through the Web UI,
            MQTT or factory data.

    config OTA_SERVER_URL
        string "Default OTA Server URL"
        default ""
        depends on ESPX

    choice ESPX_WIFI_PS
        bool "Wi-Fi power save"
        default ESPX_WIFI_PS_NONE
        depends on ESPX
        help
            Modem sleep lets the radio doze between beacons, which saves power
            but adds hundreds of milliseconds to every request: the device only
            wakes on a DTIM beacon, so each TLS handshake (several round trips)
            becomes slow and can even time out.

            NONE  - no power save. Recommended for a mains-powered node that
                    serves an HTTPS UI: sub-10 ms LAN latency.
            MIN   - minimum modem sleep. Roughly 100-300 ms latency, clearly
                    less current. Reasonable for a battery node that is only
                    polled occasionally.

        config ESPX_WIFI_PS_NONE
            bool "None (lowest latency)"
        config ESPX_WIFI_PS_MIN
            bool "Minimum modem sleep (lower power)"
    endchoice

    # =====================================================================
    # Serial AT interface
    # =====================================================================

    config ESPX_AT_ENABLE
        bool "Serial AT command interface"
        default y
        depends on ESPX
        help
            ESP-AT style command interface on a dedicated UART. A host MCU can
            commission and drive the node with AT commands; every mutating
            command goes through the same configuration path as the Web API and
            MQTT (see AGENT.md).

            The command set is a documented SUBSET of ESP-AT, not the whole
            command table. Run AT+HELP? for the supported list.

    config ESPX_AT_UART_NUM
        int "AT UART number"
        range 0 2
        default 1
        depends on ESPX_AT_ENABLE
        help
            UART used for AT commands. Defaults to UART1 so the AT port and the
            log / manufacturing console (UART0) stay independent.

            Choosing 0 shares the port with the log output and the test-mode
            console, where the two will interleave.

    config ESPX_AT_UART_TX_GPIO
        int "AT UART TX GPIO"
        default 4
        depends on ESPX_AT_ENABLE
        help
            ESP32-S3: avoid the strapping pins (0/3/45/46), the flash pins
            (26-32), the octal PSRAM pins (33-37) and the USB pins (19/20).

    config ESPX_AT_UART_RX_GPIO
        int "AT UART RX GPIO"
        default 5
        depends on ESPX_AT_ENABLE

    config ESPX_AT_UART_BAUD
        int "AT UART baud rate"
        default 115200
        depends on ESPX_AT_ENABLE

    # =====================================================================
    # Network services (require an IP address)
    # =====================================================================

    config ESPX_NTP_SERVER
        string "NTP server"
        default "pool.ntp.org"
        depends on ESPX
        help
            SNTP server used to set the clock once the station is connected.
            A correct clock is needed for certificate validity checks and for
            log timestamps that can be correlated across devices.

    config ESPX_TZ
        string "Timezone (POSIX TZ)"
        default "CST-8"
        depends on ESPX
        help
            POSIX TZ string, e.g. "CST-8" (China), "UTC0", "EST5EDT",
            "AEST-10AEDT,M10.1.0,M4.1.0/3". Applied at boot.

    # The mDNS name is the device id, lower-cased and sanitised, so it always
    # matches the MQTT topic prefix. There is deliberately no separate prefix
    # option: "<prefix><device_id>" duplicated the product prefix and produced
    # names such as "espx-espx-84c7bb772e74.local".

    config ESPX_MDNS_ADVERTISE_MQTT
        bool "Also advertise _mqtt._tcp"
        default n
        depends on ESPX
        help
            Only useful when a broker runs on the node itself.

    config ESPX_HTTPS_PORT
        int "HTTPS server port"
        default 443
        depends on ESPX
        help
            Port the management interface and REST API listen on. Also used for
            the advertised _https._tcp mDNS service.

    config ESPX_WS_ENABLE
        bool "WebSocket endpoint (/ws)"
        default y
        depends on ESPX
        help
            Push device state to browsers without polling, and accept
            read/write/config commands over the socket.

    # =====================================================================
    # Wi-Fi provisioning
    # =====================================================================

    choice ESPX_PROV_TRANSPORT
        bool "Provisioning transport"
        default ESPX_PROV_TRANSPORT_BLE
        help
            How an unprovisioned device receives Wi-Fi credentials.

            BLE  - phone app / Bluetooth. Default. No access point is created,
                   so the device exposes no open network and has no IP until it
                   joins the configured Wi-Fi.
            SoftAP - the device raises its own access point and is configured
                   over HTTP. Useful when no BLE-capable client is available.
                   Note: during provisioning the config UI is reachable by
                   anyone in radio range (see docs/ARCHITECTURE.md limitation 9).

            Either way, a device carrying pre-provisioned credentials
            (network.wifi_ssid in factory data) joins that network directly and
            never starts the provisioning service.

        config ESPX_PROV_TRANSPORT_BLE
            bool "BLE"
            select BT_ENABLED
            depends on !IDF_TARGET_ESP32S2

        config ESPX_PROV_TRANSPORT_SOFTAP
            bool "SoftAP"
            select LWIP_IPV4
    endchoice

    config ESPX_PROV_TRANSPORT
        int
        default 1 if ESPX_PROV_TRANSPORT_BLE
        default 2 if ESPX_PROV_TRANSPORT_SOFTAP

    choice ESPX_PROV_SECURITY_VERSION
        bool "Provisioning security version"
        default ESPX_PROV_SECURITY_VERSION_1
        help
            Protocomm security for the provisioning session.
            Security 1 (X25519 + proof-of-possession) is what the Espressif
            provisioning apps use by default and needs only a PoP string.
            Security 2 (SRP6a) needs a per-device salt/verifier.

        config ESPX_PROV_SECURITY_VERSION_0
            bool "Security 0 (no security, plain text)"
            select ESP_PROTOCOMM_SUPPORT_SECURITY_VERSION_0

        config ESPX_PROV_SECURITY_VERSION_1
            bool "Security 1 (X25519 + PoP)"
            select ESP_PROTOCOMM_SUPPORT_SECURITY_VERSION_1

        config ESPX_PROV_SECURITY_VERSION_2
            bool "Security 2 (SRP6a)"
            select ESP_PROTOCOMM_SUPPORT_SECURITY_VERSION_2
    endchoice

    config ESPX_PROV_POP
        string "Proof of possession (Security 1)"
        default "abcd1234"
        depends on ESPX_PROV_SECURITY_VERSION_1
        help
            Shared secret the provisioning client must present.
            MUST be changed for production.

    config ESPX_PROV_SEC2_USERNAME
        string "SRP6a username (Security 2)"
        default "wifiprov"
        depends on ESPX_PROV_SECURITY_VERSION_2

    config ESPX_PROV_SEC2_PASSWORD
        string "SRP6a password (Security 2, development mode)"
        default "abcd1234"
        depends on ESPX_PROV_SECURITY_VERSION_2

    config ESPX_PROV_SEC2_DEV_MODE
        bool "Security 2 development mode (hard-coded salt/verifier)"
        default y
        depends on ESPX_PROV_SECURITY_VERSION_2
        help
            Uses a salt/verifier compiled into the firmware.
            NOT suitable for production: every device would share the same
            credentials. Disable and supply per-device values from the
            manufacturing partition for production builds.

    config ESPX_PROV_SOFTAP_PREFIX
        string "SoftAP SSID prefix"
        default "PROV_"
        depends on ESPX_PROV_TRANSPORT_SOFTAP
        help
            Final SSID is the prefix followed by the last three bytes of the
            station MAC.

    config ESPX_PROV_SHOW_QR
        bool "Print a provisioning QR code on the console"
        default y

    config ESPX_PROV_SHOW_POP_IN_QR
        bool "Include the PoP in the QR code"
        default y
        depends on ESPX_PROV_SECURITY_VERSION_1 && ESPX_PROV_SHOW_QR
        help
            Convenient during development. Disable for production: the QR code
            is then printed without the shared secret.

    config ESPX_PROV_ENABLE_APP_CALLBACK
        bool "Enable the application provisioning callback"
        default n
        help
            Runs a blocking callback for provisioning events, for advanced
            use-cases such as adjusting the station configuration.

    config ESPX_PROV_RESET_ON_FAILURE
        bool "Reset the provisioning state machine after repeated failures"
        default y

    config ESPX_PROV_CONNECTION_COUNT
        int "Station connection attempts before reset"
        default 5
        depends on ESPX_PROV_RESET_ON_FAILURE
        help
            Guards against endlessly retrying an unreachable AP or wrong
            credentials.

    config ESPX_PROV_REPROVISIONING
        bool "Allow re-provisioning after a successful setup"
        default n

endmenu
```

## sdkconfig.defaults.esp32c3
```kconfig
# ESP-IDF Configuration for ESP32-C3 Super Mini

# Target chip
CONFIG_IDF_TARGET="esp32c3"
CONFIG_IDF_TARGET_ESP32C3=y

# Partition table
CONFIG_PARTITION_TABLE_CUSTOM=y
CONFIG_PARTITION_TABLE_CUSTOM_FILENAME="partitions_esp32c3.csv"

# WiFi (ESP32-C3 uses IEEE 802.11b/g/n)
CONFIG_ESP32C3_WIFI_STATIC_RX_BUFFER_NUM=10
CONFIG_ESP32C3_WIFI_DYNAMIC_RX_BUFFER_NUM=32
CONFIG_ESP32C3_WIFI_TX_BUFFER_TYPE=1

# MQTT
CONFIG_MQTT_TRANSPORT_SSL=y
CONFIG_MQTT_PROTOCOL_311=y
CONFIG_MQTT_TASK_STACK_SIZE=4096

# Log
CONFIG_LOG_DEFAULT_LEVEL_INFO=y
CONFIG_LOG_MAXIMUM_LEVEL_VERBOSE=y

# System - ESP32-C3 typical settings
CONFIG_ESPTOOLPY_FLASHFREQ_80M=y
CONFIG_ESPTOOLPY_FLASHMODE_DIO=y
CONFIG_ESPTOOLPY_FLASHSIZE_4MB=y

# ESP32-C3 specific - RISC-V CPU
CONFIG_ESP32C3_DEFAULT_CPU_FREQ_160=y

# Enable RNG for security
CONFIG_ESP_RANDOM_ENABLE=y

# FreeRTOS
CONFIG_FREERTOS_HZ=1000

# BLE support (ESP32-C3 has Bluetooth LE only)
CONFIG_BT_ENABLED=y
CONFIG_BT_NIMBLE_ENABLED=y

# USB CDC (ESP32-C3-S3 has native USB)
CONFIG_ESP_CONSOLE_USB_SERIAL_JTAG=y
```

## sdkconfig.defaults.esp32c6
```kconfig
# ESP-IDF Configuration for ESP32-C6

# Target chip
CONFIG_IDF_TARGET="esp32c6"
CONFIG_IDF_TARGET_ESP32C6=y

# Partition table
CONFIG_PARTITION_TABLE_CUSTOM=y
CONFIG_PARTITION_TABLE_CUSTOM_FILENAME="partitions_esp32c3.csv"

# WiFi (ESP32-C6 supports 2.4GHz WiFi 6)
CONFIG_ESP32C6_WIFI_STATIC_RX_BUFFER_NUM=10
CONFIG_ESP32C6_WIFI_DYNAMIC_RX_BUFFER_NUM=32
CONFIG_ESP32C6_WIFI_TX_BUFFER_TYPE=1

# MQTT
CONFIG_MQTT_TRANSPORT_SSL=y
CONFIG_MQTT_PROTOCOL_311=y
CONFIG_MQTT_TASK_STACK_SIZE=4096

# Log
CONFIG_LOG_DEFAULT_LEVEL_INFO=y
CONFIG_LOG_MAXIMUM_LEVEL_VERBOSE=y

# System
CONFIG_ESPTOOLPY_FLASHFREQ_80M=y
CONFIG_ESPTOOLPY_FLASHMODE_DIO=y
CONFIG_ESPTOOLPY_FLASHSIZE_4MB=y

# ESP32-C6 specific - RISC-V CPU
CONFIG_ESP32C6_DEFAULT_CPU_FREQ_160=y

# BLE 5.0 support (ESP32-C6 has Bluetooth LE 5.0)
CONFIG_BT_ENABLED=y
CONFIG_BT_NIMBLE_ENABLED=y
CONFIG_BT_LE_SMP_ENABLE=y

# USB CDC
CONFIG_ESP_CONSOLE_USB_SERIAL_JTAG=y

# FreeRTOS
CONFIG_FREERTOS_HZ=1000
```

## sdkconfig.defaults.esp32s3
```kconfig
# ESP-IDF Configuration for ESP32-S3

# Target chip
CONFIG_IDF_TARGET="esp32s3"
CONFIG_IDF_TARGET_ESP32S3=y

# Partition table
CONFIG_PARTITION_TABLE_CUSTOM=y
CONFIG_PARTITION_TABLE_CUSTOM_FILENAME="partitions.csv"

# WiFi
CONFIG_ESP32S3_WIFI_STATIC_RX_BUFFER_NUM=10
CONFIG_ESP32S3_WIFI_DYNAMIC_RX_BUFFER_NUM=32
CONFIG_ESP32S3_WIFI_TX_BUFFER_TYPE=1

# MQTT
CONFIG_MQTT_TRANSPORT_SSL=y
CONFIG_MQTT_PROTOCOL_311=y
CONFIG_MQTT_TASK_STACK_SIZE=4096

# Log
CONFIG_LOG_DEFAULT_LEVEL_INFO=y
CONFIG_LOG_MAXIMUM_LEVEL_VERBOSE=y

# System
CONFIG_ESPTOOLPY_FLASHFREQ_80M=y
CONFIG_ESPTOOLPY_FLASHMODE_DIO=y
CONFIG_ESPTOOLPY_FLASHSIZE_4MB=y

# ESP32-S3 specific
CONFIG_ESP32S3_DEFAULT_CPU_FREQ_240=y

# USB CDC (ESP32-S3 has native USB)
CONFIG_ESP_CONSOLE_USB_SERIAL_JTAG=y

# FreeRTOS
CONFIG_FREERTOS_HZ=1000

# mDNS / DNS
CONFIG_LWIP_DNS_SUPPORT_MDNS_QUERIES=y
CONFIG_LWIP_MDNS_RESPONDER=y
CONFIG_LWIP_NUM_NETIF_CLIENT_DATA=2
CONFIG_ESP_LOCAL_CTRL=n
```

## sdkconfig.defaults.esp8266
```kconfig
# ESP-IDF Configuration for NodeMCU-12F (ESP8266)

# Target chip
CONFIG_IDF_TARGET="esp8266"
CONFIG_IDF_TARGET_ESP8266=y

# Partition table (ESP8266 has limited flash)
CONFIG_PARTITION_TABLE_CUSTOM=y
CONFIG_PARTITION_TABLE_CUSTOM_FILENAME="partitions_esp8266.csv"

# WiFi (ESP8266 only supports 2.4GHz b/g/n)
CONFIG_ESP8266_WIFI_STATIC_RX_BUFFER_NUM=10
CONFIG_ESP8266_WIFI_DYNAMIC_RX_BUFFER_NUM=32

# MQTT
CONFIG_MQTT_TRANSPORT_SSL=y
CONFIG_MQTT_PROTOCOL_311=y
CONFIG_MQTT_TASK_STACK_SIZE=4096

# Log
CONFIG_LOG_DEFAULT_LEVEL_INFO=y
CONFIG_LOG_MAXIMUM_LEVEL_VERBOSE=y

# System
CONFIG_ESPTOOLPY_FLASHFREQ_40M=y
CONFIG_ESPTOOLPY_FLASHMODE_DIO=y
CONFIG_ESPTOOLPY_FLASHSIZE_4MB=y

# ESP8266 specific
CONFIG_ESP8266_CPU_FREQ_160=y
CONFIG_ESP8266_IRAM_SAFE=y

# FreeRTOS
CONFIG_FREERTOS_HZ=1000

# Disable features not supported by ESP8266
CONFIG_ESPTOOLPY_BAUD_921600B=
CONFIG_FLASHMODE_DIO=y
```
